
/********************金逸晨**************************
*****************GM12864T-5D    9PIN SPI LCD FOR STM8S*************
*****STM8S003F3驱动**************************
***** PC3----3  SCK   ,  PC4----4  SDA   ,    PC5---5  RST   ,
      PC6    ---6   DC   ,    PC7 ----7   CS
*********ST7565R
本模块自带背光限流电阻，可直接将LED_A接VDD,LED_K接GND

90度旋转显示，图片需要更改取模方式

演示代码仅演示16*15汉字旋转
********************************************************/
#include "IOSTM8S003F3.h"


#define LCD_DIS_CHINA_ROT  90				//选择屏幕旋转参数，不旋转0，旋转90度：90，旋转180度：180
//#define LCD_DIS_CHINA_ROT  180
//#define LCD_DIS_CHINA_ROT  0

#define LCD_COLUMN_NUMBER 128
#define LCD_LINE_NUMBER 64 

	#if  (LCD_DIS_CHINA_ROT == 180) 
	#define LCD_COLUMN_OFFSET 3					//旋转180度需要加3个偏移量
	#else 
	#define LCD_COLUMN_OFFSET 1
	#endif
	

#define LCD_PAGE_NUMBER (LCD_LINE_NUMBER/8)
#define LCD_COMMAND_NUMBER  14


#define set_0   0x01
#define set_1   0x02
#define set_2   0x04
#define set_3   0x08    
#define set_4   0x10
#define set_5   0x20
#define set_6   0x40
#define set_7   0x80

#define clr_0   0xFE
#define clr_1   0xFD
#define clr_2   0xFB
#define clr_3   0xF7    
#define clr_4   0xEF
#define clr_5   0xDF
#define clr_6   0xBF
#define clr_7   0x7F


/**********IIC引脚分配，连接oled屏，更具实际情况修改*********/

#define SPI_SDA_0  PC_ODR&=clr_3        //PC3       
#define SPI_SDA_1  PC_ODR|=set_3       
#define SPI_SCK_0  PC_ODR&=clr_4        //PC4        
#define SPI_SCK_1  PC_ODR|=set_4
#define SPI_DC_0  PC_ODR&=clr_5        //PC5        
#define SPI_DC_1  PC_ODR|=set_5
#define SPI_RST_0  PC_ODR&=clr_6           //PC6
#define SPI_RST_1  PC_ODR|=set_6
#define SPI_CS_0  PC_ODR&=clr_7          //PC7
#define SPI_CS_1  PC_ODR|=set_7

const unsigned char  *point;
unsigned char READ_BACK[32];                    ////一个汉字最大返回32个字节
unsigned char CHAR_DATA[32];
const unsigned char  LCD_init_cmd[LCD_COMMAND_NUMBER]=
{
        0xa2,//bias set:1/9
		 0xa0,//ADC select:nomal,0->128
		 0xa6,//normal/reverse  display
		 0xc8,//commom output mode select: reverse
		 0xf8,//booster ratio set
		 0x00,//booster ratio:4x
		 0x2f,//power control set
		 0x26,//set (Rb/Ra)
		 0x81,//vo output voltage set
		 0x09,//voltage volume =9.0v
	#if (LCD_DIS_CHINA_ROT == 180) 
	0xA1, //列扫描顺序：从左到右
	0xc0, //行扫描顺序：反序
	#else 
	0xA0, //列扫描顺序：从左到右
	0xc8, //行扫描顺序：反序
	#endif
		 0x60,//set start line
		 0xaf,//display on  
};

const unsigned char  picture_tab[]={
/*------------------------------------------------------------------------------
;  列行式，低位在前，阴码
;  宽×高（像素）: 128×64
------------------------------------------------------------------------------*/
    0xFF,0x01,0x01,0x01,0x01,0x01,0x01,0x01,0x01,0x01,0x01,0x01,0x01,0x01,0x01,0x01,
0x01,0x01,0x01,0x01,0x01,0x01,0x01,0x01,0x01,0x01,0x01,0x01,0x01,0x01,0x01,0x01,
0x01,0x01,0x01,0x01,0x01,0x01,0x01,0x01,0x01,0x01,0x01,0x01,0x01,0x01,0x01,0x01,
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0x80,0x80,0x80,0x80,0x80,0x80,0x80,0x80,0x80,0x80,0x80,0x80,0x80,0x80,0x80,0xFF

};
const unsigned char  China_tab[][32]={
/*------------------------------------------------------------------------------
;  列行式，低位在前，阴码
;  
------------------------------------------------------------------------------*/
{0x10,0x60,0x02,0x8C,0x00,0x0E,0x22,0x12,0x0A,0xC2,0x0A,0x12,0x22,0x0E,0x00,0x00,
0x04,0x04,0x7E,0x01,0x20,0x21,0x11,0x09,0x05,0xFF,0x05,0x09,0x11,0x21,0x20,0x00},/*"深",0*/

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{0x80,0x82,0x82,0x82,0x82,0x82,0x82,0xE2,0xA2,0x92,0x8A,0x86,0x82,0x80,0x80,0x00,
0x00,0x00,0x00,0x00,0x00,0x40,0x80,0x7F,0x00,0x00,0x00,0x00,0x00,0x00,0x00,0x00},/*"子",6*/

};
/*******时钟初始化******************/
void CLK_init(void)
{
  
  CLK_CKDIVR|= 0x00;       /*设置时钟为内部16M高速时钟*/ 
}
void delay_us(unsigned int _us_time)
{       
  unsigned char x=0;
  for(;_us_time>0;_us_time--)
  {
    x++;
  }
}
void delay_ms(unsigned int _ms_time)
  {
    unsigned int i,j;
    for(i=0;i<_ms_time;i++)
    {
    for(j=0;j<900;j++)
      {;}
    }
  }

/*************SPI配置函数*******************
，SCL空闲时低电平，第一个上升沿采样
模拟SPI
******************************************/

/**************************SPI模块发送函数************************************************

 *************************************************************************/
void SPI_SendByte(unsigned char byte)
{
  
  unsigned char counter;
   
  for(counter=0;counter<8;counter++)
  { 
    SPI_SCK_0;
    if((byte&0x80)==0)
    {
      SPI_SDA_0;
    }
    else SPI_SDA_1;
    byte=byte<<1;
    SPI_SCK_1;	     
  } 
}

void LCD_send_cmd(unsigned char o_command)
  {
    SPI_DC_0;
    SPI_CS_0;
    SPI_SendByte(o_command);
    SPI_CS_1;
	 
    //SPI_DC_1;
  }
void LCD_send_data(unsigned char o_data)
  { 
    SPI_DC_1;
    SPI_CS_0;
    SPI_SendByte(o_data);
    SPI_CS_1;
	  
   }
void Column_set(unsigned char column)
  {
	column+=LCD_COLUMN_OFFSET;
    LCD_send_cmd(0x10|(column>>4));    //设置列地址高位
    LCD_send_cmd(0x00|(column&0x0f));   //设置列地址低位  
    	 
  }
void Page_set(unsigned char page)
  {
    LCD_send_cmd(0xb0+page);
  }
void LCD_clear(void)
  {
    unsigned char page,column;
    for(page=0;page<LCD_PAGE_NUMBER;page++)             //page loop
      { 
          Page_set(page);
          Column_set(0);	  
          for(column=0;column<LCD_COLUMN_NUMBER;column++)	//column loop
            {
              LCD_send_data(0x00);
            }
      }
  }
void LCD_full(void)
  {
    unsigned char page,column;
    for(page=0;page<LCD_PAGE_NUMBER;page++)             //page loop
      { 
        Page_set(page);
        Column_set(0);	  
	for(column=0;column<LCD_COLUMN_NUMBER;column++)	//column loop
          {
            LCD_send_data(0xff);
          }
      }
  }
void LCD_init(void)
  {
    unsigned char i;
    for(i=0;i<LCD_COMMAND_NUMBER;i++)
      {
        LCD_send_cmd(LCD_init_cmd[i]);
      }
  }

void Picture_display(const unsigned char *ptr_pic)
  {
    unsigned char page,column;
    for(page=0;page<(LCD_LINE_NUMBER/8);page++)        //page loop
      { 
	Page_set(page);
	Column_set(0);	  
	for(column=0;column<LCD_COLUMN_NUMBER;column++)	//column loop
          {
            LCD_send_data(*ptr_pic++);
          }
      }
  }
void Picture_ReverseDisplay(const unsigned char *ptr_pic)
{
    unsigned char page,column,data;
    for(page=0;page<(LCD_LINE_NUMBER/8);page++)        //page loop
      { 
	Page_set(page);
	Column_set(0);	  
	for(column=0;column<LCD_COLUMN_NUMBER;column++)	//column loop
          {
            data=*ptr_pic++;
            data=~data;
            LCD_send_data(data);
          }
      }
  }
void dis_data_90_(void)					//15*16字库转换90度旋转
{
	unsigned char  x=0,y=0,z=0x01;
	for (x=0;x<32;x++)
	{
		CHAR_DATA[x]=0;	//字体缓存清零
	}
	z=0x01;
	for (x=16;x<24;x++)
	{
		for (y=0;y<8;y++)
		{
			CHAR_DATA[x]<<= 1;
			if (READ_BACK[y] & z)
				
			{
				CHAR_DATA[x]|=0x01;
			}			
		}
		z=z<<1;
	}
	z=0x01;
	for (x=0;x<8;x++)
	{
		for (y=8;y<16;y++)
		{
			CHAR_DATA[x]<<= 1;
			if (READ_BACK[y] & z)
				
			{
				CHAR_DATA[x]|=0x01;
			}			
		}
		z=z<<1;
	}
	z=0x01;
	for (x=24;x<32;x++)
	{
		for (y=16;y<24;y++)
		{
			CHAR_DATA[x]<<= 1;
			if (READ_BACK[y] & z)
				
			{
				CHAR_DATA[x]|=0x01;
			}			
		}
		z=z<<1;
	}
	z=0x01;
	for (x=8 ;x<16;x++)
	{
		for (y=24;y<32;y++)
		{
			CHAR_DATA[x]<<= 1;
			if (READ_BACK[y] & z)
				
			{
				CHAR_DATA[x]|=0x01;
			}			
		}
		z=z<<1;
	}
}
  void display_one_word(unsigned char X_ADD,unsigned char Y_ADD,const unsigned char * chinese_char)
{
  unsigned char x=0;
 /* union 
  {
    unsigned int int_data;
    unsigned char char_data[2];
    
  }int_2_char;
  int_2_char.int_data = chinese_char;*/
	
	for (x=0;x<32;x++)
		{
			READ_BACK[x]= * (chinese_char+x);
		}
	#if (LCD_DIS_CHINA_ROT == 90)
		dis_data_90_();
	#else 
		for (x=0;x<32;x++)
		{
			CHAR_DATA[x]= * (chinese_char+x);
		}
	#endif
  Page_set(Y_ADD);
  Column_set(X_ADD);
  
  for (x=0;x<16;x++)
  {
    LCD_send_data(CHAR_DATA[x]);
  }
  
  Page_set(Y_ADD+1);
  Column_set(X_ADD);
  
  for (x=16;x<32;x++)
  {
    LCD_send_data(CHAR_DATA[x]);
  }

}

void IO_init(void)
{
  PC_DDR|=0xFF;                         //PC  06,07，03,04,07推挽输出模式
  PC_CR1|=0xFF;
  PC_CR2|=0xFF;
  PC_ODR=0XFF;
}


int main( void )
{
  point= &picture_tab[0];
	CLK_init();
	IO_init();
	SPI_SCK_0;
	SPI_RST_0;
	delay_ms(10);
	SPI_RST_1;
	delay_ms(10);
	LCD_init();
	LCD_full();
	delay_ms(500);
	LCD_clear();
	while(1)
	{
		Picture_display(point);
		delay_ms(1000);
    
		Picture_ReverseDisplay(point);
		delay_ms(1000);
		LCD_clear();
		display_one_word(8,3,China_tab[0]);
		delay_ms(200);
		display_one_word(24,3,China_tab[1]);
		delay_ms(200);
		display_one_word(40,3,China_tab[2]);
		delay_ms(200);
		display_one_word(56,3,China_tab[3]);
		delay_ms(200);
		display_one_word(72,3,China_tab[4]);
		delay_ms(200);
		display_one_word(88,3,China_tab[5]);
		delay_ms(200);
		display_one_word(104,3,China_tab[6]);
		delay_ms(5000);
		
		
	}
}