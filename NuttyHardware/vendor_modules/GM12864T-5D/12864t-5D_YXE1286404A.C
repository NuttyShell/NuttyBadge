//Modle :YXM1286404 
//Driver IC:ST7565R
//Interfaces:SPI-4
#include<reg51.h>
#include<intrins.h>
#define DATAPORT P1

sbit _CS=P3^4;
sbit RES=P3^3;
sbit RS=P3^2;
sbit SCL=P3^1;/*serial clock input(D6)*/
sbit SI=P3^0;/*serial data input(D7)*/

unsigned char code initial_tab[12]={
     0xa2,//bias set:1/9
		 0xa0,//ADC select:nomal,0->128
		 0xa6,//normal/reverse  display
		 0xc8,//commom output mode select: reverse
		 0xf8,//booster ratio set
		 0x00,//booster ratio:4x
		 0x2f,//power control set
		 0x26,//set (Rb/Ra)
		 0x81,//vo output voltage set
		 0x10,//voltage volume =9.0v
		 0x60,//set start line
		 0xaf,//display on
         };
unsigned char code test_tab[16]={
                               0xff,0xff,0x00,0x00,
                               0xaa,0xaa,0x55,0x55,
			  	               0xff,0x00,0x00,0xff,
				               0xaa,0x55,0x55,0xaa};

unsigned char code picture_tab[]={
/*--  调入了一幅图像：C:\Documents and Settings\Administrator\桌面\1286403.bmp  --*/
/*--  宽度x高度=128x64  --*/
0xFF,0x01,0x01,0x01,0x01,0x01,0x01,0x01,0x01,0x01,0x01,0x01,0x01,0x01,0x01,0x01,
0x01,0x01,0x01,0x01,0x01,0x01,0x01,0x01,0x01,0x01,0x01,0x01,0x01,0x01,0x01,0x01,
0x01,0x01,0x01,0x01,0x01,0x01,0x01,0x01,0x01,0x01,0x01,0x01,0x01,0x01,0x01,0x01,
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0x80,0x80,0x80,0x80,0x80,0x80,0x80,0x80,0x80,0x80,0x80,0x80,0x80,0x80,0x80,0xFF,
};

unsigned char code picture_tab1[]={
/*--  调入了一幅图像：F:\工作\8051\OLED1\abcd.bmp  --*/
/*--  宽度x高度=128x64  --*/
0x00,0x00,0x00,0xF0,0x08,0x04,0x04,0x08,0xF0,0x00,0x04,0xFC,0x04,0x00,0x00,0x00,
0x00,0x04,0xFC,0x44,0x44,0xE4,0x0C,0x00,0x04,0xFC,0x04,0x04,0x08,0xF0,0x00,0xA8,
0xAE,0x98,0xFF,0xAC,0x8A,0x10,0xFC,0x0B,0x88,0x78,0x08,0x00,0x88,0x86,0x92,0x92,
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0x20,0x20,0x20,0x20,0x10,0x0F,0x00,0x00,0x07,0x18,0x20,0x20,0x20,0x20,0x10,0x0C,
};

unsigned char code picture_tab2[]={
/*--  调入了一幅图像：C:\Documents and Settings\Administrator\桌面\12864.bmp  --*/
/*--  宽度x高度=128x64  --*/
0xFF,0x01,0x01,0x01,0x01,0x01,0x01,0x01,0x01,0x01,0x01,0x01,0x01,0x01,0x01,0x01,
0x01,0x01,0x01,0x01,0x81,0x81,0x81,0x81,0x81,0x81,0x81,0x81,0x81,0x81,0x81,0x81,
0x81,0x01,0x01,0x01,0x01,0x01,0x01,0x01,0x01,0x01,0x01,0x01,0x81,0x81,0x81,0x81,
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0x80,0x80,0x80,0x80,0x80,0x80,0x80,0x80,0x80,0x80,0x80,0x80,0x80,0x80,0x80,0xFF,
};


void Delay(unsigned int time)
        {
		  unsigned int i,j;
		  for(i=0;i<time;i++)
		     for(j=0;j<10000;j++)
			       {;}
		}
void Ins_trans(unsigned char command)
  { 
    unsigned char counter;
	  _CS=0;
	  RS=0;
    for(counter=0;counter<8;counter++)
       {
         SI=((command&0x80)==0x80);
		     SCL=0;
        // _nop_();
	       _nop_();
		     SCL=1;
	     //  _nop_();
		     _nop_();
		     SCL=0;
         command<<=1;
        }
   _CS=1;
  }
void Data_trans(unsigned char command)
  { 
    unsigned char counter;
	  _CS=0;
	  RS=1;
    for(counter=0;counter<8;counter++)
       {
         SI=((command&0x80)==0x80);
		     SCL=0;
         //_nop_();
	       _nop_();
		     SCL=1;
	      // _nop_();
		     _nop_();
		     SCL=0;
         command<<=1;
        }
   _CS=1;
   }
void Column_set(unsigned char column)
          {
		     Ins_trans(0x10|(column>>4));
		     Ins_trans(0x00|(column&0x0f));	 
		  }
void Page_set(unsigned char page)
          {
		    Ins_trans(0xb0+page);
		  }
void Screen_clear()
       {
	     unsigned char page,column;
 		  for(page=0;page<8;page++)             //page loop
		     { 
			   Page_set(page);
			   Column_set(1);	  
			   for(column=1;column<129;column++)	//column loop
			      {
				     Data_trans(0x00);
				    }
			   }
	     }
void Initial()
          {
		    unsigned char i;
			for(i=0;i<12;i++)
			   {
			     Ins_trans(initial_tab[i]);
			   }
		  }
void Test_display()
         {
		    unsigned int i,page,column;
		    //Ins_trans(0x81);
		    //Ins_trans(0x20);
			for(i=0;i<16;i+=2)              //picture loop
			    { 
				  for(page=0;page<8;page++)   //page loop
				    { 
					  Page_set(page);
					  Column_set(1);
					  for(column=0;column<64;column++)   //column loop
					     {
						     Data_trans(test_tab[i]);
							 Data_trans(test_tab[i+1]);
                             //Delay(1);
						 }
					}
				   Delay(15); 
				}
		   
		 } 
void Picture_display(unsigned char *ptr_pic)
        {
		  unsigned char page,column;
		  //Ins_trans(0x81);
		  //Ins_trans(0x1F);
 		  for(page=0;page<(64/8);page++)        //page loop
		     { 
			   Page_set(page);
			   Column_set(1);	  
			   for(column=1;column<129;column++)	//column loop
			      {
				     Data_trans(*ptr_pic++);
				  }
			 }
		  Delay(15);
		}

void main()
     { 
		  RES=0;
		  Delay(5);
		  RES=1;
		  Initial();
		  while(1)
		     {
			   Screen_clear();   
			   Picture_display(picture_tab);
			   Picture_display(picture_tab1);
			   Picture_display(picture_tab2);
			   Test_display();
			 }
	 }


